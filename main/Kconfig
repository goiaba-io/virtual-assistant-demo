## main/Kconfig
```kconfig
menu "Wi-Fi credentials"

config WIFI_CONNECT_SSID
    string "Wi-Fi SSID"
    default "your_ssid"
    help
      Your Wi-Fi network's SSID.

config WIFI_CONNECT_PASSWORD
    string "Wi-Fi Password"
    default "your_password"
    help
      Your Wi-Fi network's password.

endmenu

menu "OpenAI configuration"

config OPENAI_REALTIMEAPI
    string "OpenAI Realtime API URL"
    default "https://api.openai.com/v1/realtime?model=gpt-4o-mini-realtime-preview"
    help
      The REST endpoint to POST signaling-type payloads (e.g. SDP offers) to OpenAI.

config OPENAI_API_KEY
    string "OpenAI API Key"
    default "sk-"
    help
      Your OpenAI secret key for authorization.

config OPENAI_MODEL
    string "OpenAI Model"
    default "gpt-4o-mini-realtime-preview"
    help
      The OpenAI model to use for the virtual assistant.

config OPENAI_VOICE
    string "OpenAI Voice"
    default "coral"
    help
      The voice to use for text-to-speech synthesis.

endmenu
```
